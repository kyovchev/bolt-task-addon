## TBv2023-Firmware/IDF/patch/main/Kconfig.projbuild
```kconfig
menu "Task Board Hardware Configuration"

    choice CONTROLLER_HARDWARE
        prompt "Select M5STACK Hardware Profile"
        default M5STACK_STICK_S3
        help
            Choose the target M5Stack device you are compiling this firmware for.

        config M5STACK_STICK_S3
            bool "M5STACK StickS3"

        config M5STACK_STICKC_PLUS2
            bool "M5STACK StickC Plus2"
    endchoice

    choice PIN_LAYOUT_PROFILE
        prompt "Use external Pins"
        default PIN_PROFILE_EXTERNAL
        help
            Use external pins or use both infrared sensors with special cable

        config PIN_PROFILE_EXTERNAL
            bool "Use external pins"

        config PIN_PROFILE_INFRARED_Y_CABLE
            bool "Use both infrared sensors with special cable"
    endchoice

endmenu
```

## TBv2023-Firmware/IDF/patch/sdkconfig.defaults
```kconfig
# Optimize for size/speed balance
CONFIG_COMPILER_OPTIMIZATION_SIZE=y

# Use a custom partition table file
CONFIG_PARTITION_TABLE_CUSTOM=y
CONFIG_PARTITION_TABLE_CUSTOM_FILENAME="partitions.csv"
CONFIG_PARTITION_TABLE_FILENAME="partitions.csv"

# Bump default flash size to 8MB
CONFIG_ESPTOOLPY_FLASHSIZE_8MB=y
CONFIG_ESPTOOLPY_FLASHSIZE="8MB"

# FreeRTOS Task Runtime Stats (Fixed missing CONFIG_ prefixes)
CONFIG_FREERTOS_USE_TRACE_FACILITY=y
CONFIG_FREERTOS_USE_STATS_FORMATTING_FUNCTIONS=y
CONFIG_FREERTOS_GENERATE_RUN_TIME_STATS=y
CONFIG_FREERTOS_RUN_TIME_COUNTER_TYPE_U32=y

# Increase Main Task (app_main) Stack Size to 16KB (Fixed value to 16384)
CONFIG_ESP_MAIN_TASK_STACK_SIZE=16384

# WebSocket server support (Fixed missing CONFIG_ prefix)
CONFIG_HTTPD_WS_SUPPORT=y
```
